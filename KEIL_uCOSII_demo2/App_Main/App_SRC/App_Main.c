 /*******************************************************************
 文件名称：App_Main.c
 功能说明：FL2440硬件uCOS-II系统下应用程序主文件
 编写：张锡冰 阿呆的游乐园 河北大学
 	   于保定飞凌嵌入式
 时间：2010/8/15
 其他说明：仅提供最基本的测试，检验系统已经移植成功，本demo的目标是没
 		   有一丝赘余
 移植记录：通过J-Link观察，已进入应用程序区，下一步是添加测试代码
 		   2010/8/16
		   测试代码已经添加完毕，其实任务创建四个子任务分别负责板子上
		   一个LED的两灭，频率1S
		   2010/8/20
 *******************************************************************/

#include <includes.h>				//所有包含的相关文件都在此文件里面

#include	"App.h"	  				//用户程序头文件



/*******************************************************************
函数名称：App_Main()
功能说明：用户应用程序入口
入口参数：无
出口参数：无
编写：张锡冰 阿呆的游乐园 河北大学
时间：2010/8/17
修改记录：无
其他说明：版权所有，盗版请注明出处
*******************************************************************/
void App_Main()
{
	OSInit();

	AppInit();

	OSTaskCreate(TaskStart,
				 (void *)0,
				 &TaskStartStk[TASK_STK_SIZE - 1],
				 0
				);

	OSStart();
}

/*******************************************************************
函数名称：TaskStart()
功能说明：测试程序起始任务，创建4个任务分别控制4个LED每秒取反一次
入口参数：无
出口参数：无
编写：张锡冰 阿呆的游乐园 河北大学
时间：2010/8/17
修改记录：无
其他说明：版权所有，盗版请注明出处
*******************************************************************/
void TaskStart(void *pdata)
{
#if	OS_CRITICAL_MOTHOD == 3u
	OS_CPU_SR	cpu_sr;
#endif

	INT8U i;

	pdata = pdata;

//	OSStartInit();     //测试使用的CPU速度,使用率,可以不适用

	OSTickEnable();	//初始化并使能系统节拍中断

	for(i=0;i<4;i++)
	{
		LedNo[i] = (i+1);
		OSTaskCreate(TaskTestLed,
					 (void *) &LedNo[i],
					 &TaskTestLedStk[i][TASK_STK_SIZE - 1],
					 i+1
					);
	}
	while(1)
	{
		OSTimeDlyHMSM(0,0,1,0);
	}
}


/*******************************************************************
函数名称：TaskTestLed()
功能说明：根据所得LED编号每秒取反相应LED
入口参数：LedNum
出口参数：无
编写：张锡冰 阿呆的游乐园 河北大学
时间：2010/8/17
修改记录：无
其他说明：版权所有，盗版请注明出处
*******************************************************************/
void TaskTestLed(void *pdata)
{
#if	OS_CRITICAL_MOTHOD == 3u
	OS_CPU_SR	cpu_sr;
#endif

	INT8U LedNumber;

	LedNumber = *(INT8U *)pdata;	//读取任务获取的LED编号

	while(1)
	{
		LED_negate(LedNumber);			//取反相应LED
		OSTimeDlyHMSM(0,0,1,0);
		LED_flow();
		OSTimeDlyHMSM(0,0,1,0);			//任务延时1s
	}
}


/*********************************************************************
函数名称：AppInit()
功能说明：用户应用程序初始化
入口参数：无
出口参数：无
编写：张锡冰 阿呆的游乐园 河北大学
日期：2010/8/20
修改记录：无
其他说明：版权所有，盗版请注明出处
	    于 保定飞凌嵌入式
*********************************************************************/
void AppInit(void)
{
	LED_IO_init();

}
